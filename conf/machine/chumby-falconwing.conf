## conf/machine/chumby-falconwing.conf
```bitbake
#@TYPE: Machine
#@Name: chumby Falconwing i.MX233-based boards
#@DESCRIPTION: Machine configuration for chumby Falconwing platform

require conf/machine/include/chumby.inc
require conf/machine/include/chumby-falconwing.inc
```

## conf/machine/chumby-silvermoon-chumby8.conf
```bitbake
#@TYPE: Machine
#@Name: Silvermoon Armada 100 Development Platform
#@DESCRIPTION: Machine configuration for chumby Silvermoon board

MACHINE_EXTRA_RDEPENDS += " \
    sd8686-firmware \
    sd8686 \
    chumby-startup-hooks \
"
PREFERRED_PROVIDER_virtual/kernel = "linux-silvermoon-chumby8"

require conf/machine/include/chumby-silvermoon.inc
```

## conf/machine/chumby-silvermoon-netv.conf
```bitbake
#@TYPE: Machine
#@Name: Silvermoon Armada 100 Development Platform
#@DESCRIPTION: Machine configuration for chumby Silvermoon board
require conf/machine/include/chumby-silvermoon.inc

MACHINE_DISPLAY_WIDTH_PIXELS = "1280"
MACHINE_DISPLAY_HEIGHT_PIXELS = "720"

PREFERRED_PROVIDER_virtual/kernel = "linux-silvermoon-netv"
PACKAGE_ARCHS = "all armv5te chumby-silvermoon-netv"
MACHINE_EXTRA_RDEPENDS += " \
    compat-wireless-ath9k-htc \
    ath9k-firmware \
    netv-utils \
    chumby-startup-hooks \
    netv-recovery-blob \
"
```

## conf/machine/chumby-wintergrasp.conf
```bitbake
#@TYPE: Machine
#@Name: chumby Falconwing i.MX233-based boards
#@DESCRIPTION: Machine configuration for chumby Falconwing platform

TARGET_ARCH = "arm"

MACHINE_GUI_CLASS = "smallscreen"
MACHINE_DISPLAY_WIDTH_PIXELS = "320"
MACHINE_DISPLAY_HEIGHT_PIXELS = "240"

PREFERRED_PROVIDER_virtual/kernel = "linux-wintergrasp"
PREFERRED_PROVIDER_virtual/bootloader = "u-boot-wintergrasp"
PREFERRED_PROVIDER_chumby-blobs = "chumby-blobs-wintergrasp"

IMAGE_DEVICE_TABLES = "files/device_table-minimal-chumby.txt"

require conf/machine/include/tune-arm926ejs.inc

MACHINE_EXTRA_RDEPENDS += " \
    chumby-udev-rules \
    compat-wireless-ath9k-htc \
    ath9k-firmware \
    chumby-startup-hooks \
"

UBOOT_MACHINE = "wintergrasp_config"
UBOOT_BINARY = "u-boot"
UBOOT_LOADADDRESS = "40008000"
UBOOT_ENTRYPOINT = "40008000"

KERNEL_IMAGETYPE = "uImage"

# used by sysvinit_2
SERIAL_CONSOLE = "115200 ttyAM0"

ROOT_FLASH_SIZE = "128"
MACHINE_FEATURES = "kernel26 usbhost touchscreen ext2 ext3 vfat keyboard alsa"

# One gigabyte!
IMAGE_ROOTFS_SIZE = "128000"

ANGSTROM_MESA_VERSION = "7.9"

IMAGE_FATFS_SIZE = "${@(25 * 1024 * 1024)}"

require conf/machine/include/chumby-wintergrasp.inc
```

## conf/machine/include/chumby-falconwing.inc
```bitbake
#@TYPE: Machine
#@Name: chumby Falconwing i.MX233-based boards
#@DESCRIPTION: Machine configuration for chumby Falconwing platform

TARGET_ARCH = "arm"

MACHINE_GUI_CLASS = "smallscreen"
MACHINE_DISPLAY_WIDTH_PIXELS = "320"
MACHINE_DISPLAY_HEIGHT_PIXELS = "240"

PREFERRED_PROVIDER_virtual/kernel = "linux-falconwing"
PREFERRED_PROVIDER_virtual/bootloader = "chumby-bootshell"

IMAGE_DEVICE_TABLES = "files/device_table-minimal-chumby.txt"

require conf/machine/include/tune-arm926ejs.inc

MACHINE_EXTRA_RDEPENDS += " \
    chumby-udev-rules \
    rt73-firmware \
    chumby-startup-hooks \
    chumby-blobs-falconwing \
"

# used by sysvinit_2
SERIAL_CONSOLE = "115200 ttyAM0"

ROOT_FLASH_SIZE = "128"
MACHINE_FEATURES = "kernel26 usbhost touchscreen ext2 ext3 vfat keyboard alsa"

# 128 megabytes, to match released version
IMAGE_ROOTFS_SIZE = "128000"

ANGSTROM_MESA_VERSION = "7.9"

chumby_make_rom() {
    config_util --cmd=create \
        --mbr=/dev/zero \
        --configname=falconwing \
        --build_ver=1000 --force --pad \
        --blockdef=${DEPLOY_DIR_IMAGE}/chumby_shell.bin,215040,boot,1,0,0,0 \
        --blockdef=${DEPLOY_DIR_IMAGE}/4_1.bin,153600,img1,1,0,0,0 \
        --blockdef=${DEPLOY_DIR_IMAGE}/4_2.bin,153600,img2,1,0,0,0 \
        --blockdef=${DEPLOY_DIR_IMAGE}/5_1.bin,153600,img3,1,0,0,0 \
        --blockdef=${DEPLOY_DIR_IMAGE}/5_2.bin,153600,img4,1,0,0,0 \
        --blockdef=${DEPLOY_DIR_IMAGE}/5_3.bin,153600,img5,1,0,0,0 \
        --blockdef=${DEPLOY_DIR_IMAGE}/zImage-${MACHINE}.bin,4194304,krnA,1,0,0,0 \
        --blockdef=${DEPLOY_DIR_IMAGE}/zImage-${MACHINE}.bin,4194304,krnB,1,0,0,0 \
        > ${DEPLOY_DIR_IMAGE}/config_block.bin


    rm -f ${DEPLOY_DIR_IMAGE}/boot-${MACHINE}.bin
    touch ${DEPLOY_DIR_IMAGE}/boot-${MACHINE}.bin
    dd conv=notrunc of=${DEPLOY_DIR_IMAGE}/boot-${MACHINE}.bin seek=4 count=64 if=${DEPLOY_DIR_IMAGE}/bootstream-chumby.bin
    dd conv=notrunc of=${DEPLOY_DIR_IMAGE}/boot-${MACHINE}.bin seek=96 count=32 if=${DEPLOY_DIR_IMAGE}/config_block.bin
    dd conv=notrunc of=${DEPLOY_DIR_IMAGE}/boot-${MACHINE}.bin seek=128 count=420 if=${DEPLOY_DIR_IMAGE}/chumby_shell.bin
    dd conv=notrunc of=${DEPLOY_DIR_IMAGE}/boot-${MACHINE}.bin seek=548 count=300 if=${DEPLOY_DIR_IMAGE}/4_1.bin
    dd conv=notrunc of=${DEPLOY_DIR_IMAGE}/boot-${MACHINE}.bin seek=848 count=300 if=${DEPLOY_DIR_IMAGE}/4_2.bin
    dd conv=notrunc of=${DEPLOY_DIR_IMAGE}/boot-${MACHINE}.bin seek=1148 count=300 if=${DEPLOY_DIR_IMAGE}/5_1.bin
    dd conv=notrunc of=${DEPLOY_DIR_IMAGE}/boot-${MACHINE}.bin seek=1448 count=300 if=${DEPLOY_DIR_IMAGE}/5_2.bin
    dd conv=notrunc of=${DEPLOY_DIR_IMAGE}/boot-${MACHINE}.bin seek=1748 count=300 if=${DEPLOY_DIR_IMAGE}/5_3.bin
    dd conv=notrunc of=${DEPLOY_DIR_IMAGE}/boot-${MACHINE}.bin seek=2048 count=8192 if=${DEPLOY_DIR_IMAGE}/zImage-${MACHINE}.bin
    dd conv=notrunc of=${DEPLOY_DIR_IMAGE}/boot-${MACHINE}.bin seek=10240 count=8192 if=${DEPLOY_DIR_IMAGE}/zImage-${MACHINE}.bin

    # Make full boot ROM
    rm -f ${DEPLOY_DIR_IMAGE}/rom-${MACHINE}-${IMAGE_BASENAME}.img.gz
    install -d ${DEPLOY_DIR_IMAGE}
    makedisk -o ${DEPLOY_DIR_IMAGE}/rom-${MACHINE}-${IMAGE_BASENAME}.img \
             -a 16M:0x53:${DEPLOY_DIR_IMAGE}/boot-${MACHINE}.bin \
             -a ${ROOTFS_SIZE}k:0x83:${DEPLOY_DIR_IMAGE}/${IMAGE_LINK_NAME}.ext3
    gzip ${DEPLOY_DIR_IMAGE}/rom-${MACHINE}-${IMAGE_BASENAME}.img
}
```

## conf/machine/include/chumby-silvermoon.inc
```bitbake
#@TYPE: Machine
#@Name: Silvermoon Armada 100 Development Platform
#@DESCRIPTION: Machine configuration for chumby Silvermoon board

require conf/machine/include/tune-xscale.inc
require conf/machine/include/chumby.inc

TARGET_ARCH = "arm"

CNPLATFORM = "silvermoon"

MACHINE_GUI_CLASS = "bigscreen"
MACHINE_CLASS = "bigscreen"
MACHINE_DISPLAY_WIDTH_PIXELS = "1920"
MACHINE_DISPLAY_HEIGHT_PIXELS = "1080"
MACHINE_FEATURES = "kernel26 usbhost touchscreen ext2 ext3 vfat keyboard alsa iwmmxt wifi"
MACHINE_TASK_PROVIDER 		= "task-base"
MACHINE_ESSENTIAL_EXTRA_RDEPENDS = "u-boot-silvermoon"
MACHINE_HAS_CRYPTOPROCESSOR = "1"

PREFERRED_PROVIDER_virtual/bootloader = "u-boot-silvermoon"
PREFERRED_PROVIDER_chumby-blobs = "chumby-blobs-silvermoon"

UBOOT_MACHINE = "aspenite_config"
BOOTIMAGE_NAME = "u-boot-${MACHINE}.bin"


MACHINE_EXTRA_RDEPENDS += " \
    chumby-udev-rules \
"

MACHINE_EXTRA_RRECOMMENDS = " kernel-modules"

INITRAMFS_IMAGE = ""

module_autoload_silvermoon-tsb = "silvermoon-tsb"

# used by sysvinit_2
SERIAL_CONSOLE = "115200 ttyS0"

# Match current Silvermoon devices
ROOT_FLASH_SIZE = "180"
IMAGE_ROOTFS_SIZE = "180000"


chumby_make_rom () {
    install -d ${DEPLOY_DIR_IMAGE}

    # Create the config block header
    config_util --cmd=create \
        --mbr=/dev/zero \
        --configname=${CNPLATFORM} \
        --build_ver=${CHUMBY_BUILD} --force --pad \
        --blockdef=${DEPLOY_DIR_IMAGE}/u-boot-${MACHINE}.bin,1507328,u-bt,1,0,0,0 \
        --blockdef=${DEPLOY_DIR_IMAGE}/zImage-${MACHINE}.bin,3932160,krnA,1,0,0,0 \
        --blockdef=${DEPLOY_DIR_IMAGE}/zImage-${MACHINE}.bin,3932160,krnB,1,0,0,0 \
        --blockdef=/dev/null,16384,cpid,1,0,0,0 \
        --blockdef=/dev/null,1024,dcid,1,0,0,0 \
        > ${DEPLOY_DIR_IMAGE}/config_block.bin


    # Populate the config block
    rm -f ${DEPLOY_DIR_IMAGE}/boot-${MACHINE}.bin
    touch ${DEPLOY_DIR_IMAGE}/boot-${MACHINE}.bin
    dd conv=notrunc of=${DEPLOY_DIR_IMAGE}/boot-${MACHINE}.bin seek=0 count=96 if=${DEPLOY_DIR_IMAGE}/obm.bin
    dd conv=notrunc of=${DEPLOY_DIR_IMAGE}/boot-${MACHINE}.bin seek=96 count=32 if=${DEPLOY_DIR_IMAGE}/config_block.bin
    dd conv=notrunc of=${DEPLOY_DIR_IMAGE}/boot-${MACHINE}.bin seek=128 count=2944 if=${DEPLOY_DIR_IMAGE}/u-boot-${MACHINE}.bin
    dd conv=notrunc of=${DEPLOY_DIR_IMAGE}/boot-${MACHINE}.bin seek=3072 count=7680 if=${DEPLOY_DIR_IMAGE}/zImage-${MACHINE}.bin
    dd conv=notrunc of=${DEPLOY_DIR_IMAGE}/boot-${MACHINE}.bin seek=10752 count=7680 if=${DEPLOY_DIR_IMAGE}/zImage-${MACHINE}.bin

    package_stagefile_shell ${DEPLOY_DIR_IMAGE}/boot-${MACHINE}.bin

    # Make full boot ROM
    rm -f ${DEPLOY_DIR_IMAGE}/rom-${MACHINE}-${IMAGE_BASENAME}.img.gz
    makedisk -o ${DEPLOY_DIR_IMAGE}/rom-${MACHINE}-${IMAGE_BASENAME}.img \
             -a 16M:0x53:${DEPLOY_DIR_IMAGE}/boot-${MACHINE}.bin \
             -a ${ROOTFS_SIZE}k:0x83:${DEPLOY_DIR_IMAGE}/${IMAGE_LINK_NAME}.ext3
    gzip ${DEPLOY_DIR_IMAGE}/rom-${MACHINE}-${IMAGE_BASENAME}.img
}


chumby_make_rom_chumby-silvermoon-netv () {
    install -d ${DEPLOY_DIR_IMAGE}

    # Create the config block header
    config_util --cmd=create \
        --mbr=/dev/zero \
        --configname=${CNPLATFORM} \
        --build_ver=${CHUMBY_BUILD} --force --pad \
        --blockdef=${DEPLOY_DIR_IMAGE}/u-boot-${MACHINE}.bin,1507328,u-bt,1,0,0,0 \
        --blockdef=${DEPLOY_DIR_IMAGE}/zImage-${MACHINE}.bin,3932160,krnA,1,0,0,0 \
        --blockdef=${DEPLOY_DIR_IMAGE}/zImage-${MACHINE}.bin,3932160,krnB,1,0,0,0 \
        --blockdef=/dev/null,16384,cpid,1,0,0,0 \
        --blockdef=/dev/null,1024,dcid,1,0,0,0 \
        --blockdef=/dev/null,340992,720p,1,0,0,0 \
        --blockdef=/dev/null,1843200,logo,1,0,0,0 \
        > ${DEPLOY_DIR_IMAGE}/config_block.bin


    # Populate the config block
    rm -f ${DEPLOY_DIR_IMAGE}/boot-${MACHINE}.bin
    touch ${DEPLOY_DIR_IMAGE}/boot-${MACHINE}.bin
    dd conv=notrunc of=${DEPLOY_DIR_IMAGE}/boot-${MACHINE}.bin seek=0 count=96 if=${DEPLOY_DIR_IMAGE}/obm.bin
    dd conv=notrunc of=${DEPLOY_DIR_IMAGE}/boot-${MACHINE}.bin seek=96 count=32 if=${DEPLOY_DIR_IMAGE}/config_block.bin
    dd conv=notrunc of=${DEPLOY_DIR_IMAGE}/boot-${MACHINE}.bin seek=128 count=2944 if=${DEPLOY_DIR_IMAGE}/u-boot-${MACHINE}.bin
    dd conv=notrunc of=${DEPLOY_DIR_IMAGE}/boot-${MACHINE}.bin seek=3072 count=7680 if=${DEPLOY_DIR_IMAGE}/zImage-${MACHINE}.bin
    dd conv=notrunc of=${DEPLOY_DIR_IMAGE}/boot-${MACHINE}.bin seek=18466  count=666 if=${DEPLOY_DIR_IMAGE}/hdmi_720p.bin
    dd conv=notrunc of=${DEPLOY_DIR_IMAGE}/boot-${MACHINE}.bin seek=19132 count=3600 if=${DEPLOY_DIR_IMAGE}/logo-preparing.raw.gz

    package_stagefile_shell ${DEPLOY_DIR_IMAGE}/boot-${MACHINE}.bin



    # Make full boot ROM
    rm -f ${DEPLOY_DIR_IMAGE}/rom-${MACHINE}-${IMAGE_BASENAME}.img.gz
    makedisk -o ${DEPLOY_DIR_IMAGE}/rom-${MACHINE}-${IMAGE_BASENAME}.img \
             -a 16M:0x53:${DEPLOY_DIR_IMAGE}/boot-${MACHINE}.bin \
             -a ${ROOTFS_SIZE}k:0x83:${DEPLOY_DIR_IMAGE}/${IMAGE_LINK_NAME}.ext3
    gzip ${DEPLOY_DIR_IMAGE}/rom-${MACHINE}-${IMAGE_BASENAME}.img
}
```

## conf/machine/include/chumby-wintergrasp.inc
```bitbake
#@TYPE: Machine
#@Name: Silvermoon Armada 100 Development Platform
#@DESCRIPTION: Machine configuration for chumby Silvermoon board

CNPLATFORM = "${@bb.data.getVar('MACHINE', d, 1).replace('chumby-', '')}"
```

## conf/machine/kovan.conf
```bitbake
#@TYPE: Machine
#@Name: Silvermoon Armada 100 Development Platform
#@DESCRIPTION: Machine configuration for chumby Silvermoon board
require conf/machine/include/chumby-silvermoon.inc

MACHINE_DISPLAY_WIDTH_PIXELS = "1280"
MACHINE_DISPLAY_HEIGHT_PIXELS = "720"

PREFERRED_PROVIDER_virtual/kernel = "linux-silvermoon"
PACKAGE_ARCHS = "all armv5te kovan"
MACHINE_EXTRA_RDEPENDS += " \
    compat-wireless-ath9k-htc \
    ath9k-firmware \
    netv-utils \
    chumby-startup-hooks \
"
```
